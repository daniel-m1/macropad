## config/boards/shields/macropad/Kconfig.defconfig
```kconfig
# Copyright (c) 2020 The ZMK Contributors
# SPDX-License-Identifier: MIT

if SHIELD_MACROPAD

config ZMK_KEYBOARD_NAME
    default "macropad"

endif
```
